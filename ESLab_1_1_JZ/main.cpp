//////////////////////////////////////////////////////////////////////////////
// Laboratory AVR Microcontrollers Part1
// Program template for C lab 21
// Please fill in this information before starting coding
// Authors:
//1. Jakub Zarêbski
//2.
//3.
//4.
// Group: 2
// Section: 2
// Task number: 12
//
// Version: 2020v1.0
//////////////////////////////////////////////////////////////////////////////
#define F_CPU 16000000L
#include <avr/io.h>
#include <avr/interrupt.h>
#include <util/delay.h>
// please look into header pgmspace.h functions to properly read from ROM
#include <avr/pgmspace.h>
// please change this to proper value given by the teacher
// length of ram data table
#define nLength 300
uint8_t TAB_RAM[nLength];
uint8_t TAB_RAMTMP[nLength];

//-----------this is table with data example --------------------------------------
// please correct end of this table according to the guidelines given by the teacher
uint8_t const TAB_ROM[] PROGMEM = {
	0x00, 0x01, 0x02, 0x03, 0x04, 0x05, 0x06, 0x07, 0x08, 0x09, 0x0A, 0x0B, 0x0C, 0x0D, 0x0E, 0x1F,
	0x10, 0x11, 0x12, 0x13, 0x14, 0x15, 0x16, 0x17, 0x18, 0x19, 0x1A, 0x1B, 0x1C, 0x1D, 0x1F, 0x1F,
	0x20, 0x21, 0x22, 0x23, 0x24, 0x25, 0x26, 0x27, 0x28, 0x29, 0x2A, 0x2B, 0x2C, 0x2D, 0x2E, 0x2F,
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0x00, 0x00};
//-----this empty table example-----uncomment to test---------------
// uint8_t const TAB_ROM[] PROGMEM = { 0x00, 0x00};
//Microprocessor and Embedded Systems - Laboratory
//© 2021 v2.1 AVR Microcontrollers – part I Page 26
//---------------------------------------------------------------------

void ROM_to_RAM(void) // funkcja programu
{
	volatile uint16_t romIndex = 0, ramIndex = 0, ramIndex_even = 0;
	
	PORTB |= (1<<5); //w³¹czenie B.5
	
	while (pgm_read_word(&TAB_ROM[romIndex]) != 0x0000) // sprawdzanie czy nie ma dwóch zer z rzêdu w tablicy pamiêci rom
	{
		if (ramIndex >= nLength) // zerowanie indeksu ram w przypadku skoñczenia wielkoœci tablicy
		{
			ramIndex = 0;
		}
		
		ramIndex_even = (2 * ramIndex); // parzyste indeksy ram
		TAB_RAMTMP[ramIndex_even] = pgm_read_byte(&TAB_ROM[romIndex]); // proces kopiowania
		
		romIndex++;
		ramIndex++;
	}
	PORTB &= ~(1<<5); //wy³¹czenie B.5
}

void port_init(void) // inicjalizacja portów
{
	DDRA = 0x00; // ustawienie DDRA na wejœcie
	PORTA = 0xff; // podci¹gaj¹cy rezystor
	
	DDRB = 0b11100000; // ustawienie B.7, B.6 i B.5 jako wyjœcia a pozosta³e bity jako wejœcia, zgodnie z instrukcj¹
	PORTB = 0b00011111; // wygaszenie diód, oraz podci¹gniêcie rezystorów na bitach B.4 - B.0
	
	DDRC = 0xff; // ustawienie DDRC na wyjœcie
	PORTC = 0x00; // wygaszenie diód
	
	DDRL = 0xff; // ustawienie DDRL na wyjœcie
	PORTL = 0x00; // wygaszenie diód
	
	//pozosta³e porty z aktywowanymi podci¹gaj¹cymi rezystorami
	DDRD = 0x00;
	PORTD = 0xff;
	
	DDRE = 0x00;
	PORTE = 0xff;
	
	DDRF = 0x00;
	PORTF = 0xff;
	
	DDRG = 0x00;
	PORTG = 0xff;
	
	DDRH = 0x00;
	PORTH = 0xff;
	
	DDRJ = 0x00;
	PORTJ = 0xff;
	
	DDRK = 0x00;
	PORTK = 0xff;
}

volatile uint8_t tot_overflow; //zmienna monitoruj¹ca które przerwanie siê wykonuje
void timer1_init(void)
{
	TIMSK1 = (1 << TOIE1); //w³¹czenie przerwañ licznika Timer1
	TCCR1B = (1<<CS12) | (1<<CS10); //preskaler 1024
	TCNT1 = 63583; //wartoœæ pocz¹tkowa licznika aby uzyskaæ 125ms na jedno przerwanie
	sei(); //w³¹czenie globalnych przerwañ
	tot_overflow = 0;
}

ISR(TIMER1_OVF_vect) //funkcja przerwania
{
	// instrukcje warunkowe które decyduj¹ w których z kolei przerwaniach dioda ma siê zaœwieciæ lub zgasiæ //
	if (tot_overflow <= 4 || tot_overflow >= 6)
	{
		PORTB &= ~(1<<5); //wy³¹czenie B.5
	}
	else if (tot_overflow == 5)
	{
		PORTB |= (1<<5); //w³¹czenie B.5
	}
	
	tot_overflow++;
	TCNT1 = 63583; //reset stanu pocz¹tkowego licznika po zakoñczeniu instrukcji przerwania
}

int main ()
{
	timer1_init();
	port_init();
	ROM_to_RAM();
	
	while(1)
	{
		
	}
}
